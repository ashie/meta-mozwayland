## conf/layer.conf
```bitbake
# We have a conf and classes directory, append to BBPATH
BBPATH .= ":${LAYERDIR}"

# We have a recipes directory, add to BBFILES
BBFILES += "${LAYERDIR}/recipes-*/*/*.bb ${LAYERDIR}/recipes-*/*/*.bbappend"

BBFILE_COLLECTIONS += "mozwayland"
BBFILE_PATTERN_mozwayland := "^${LAYERDIR}/"
BBFILE_PRIORITY_mozwayland = "8"

LAYERVERSION_mozwayland = "1"
```
